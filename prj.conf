## prj.conf
```kconfig
# This is a configuration for the carbon board
CONFIG_CONSOLE_HANDLER=y
CONFIG_PRINTK=y
CONFIG_DEBUG=y

### mbed tls needed for this to work
CONFIG_MAIN_STACK_SIZE=10240
CONFIG_MBEDTLS=y
CONFIG_MBEDTLS_BUILTIN=y
CONFIG_MBEDTLS_CFG_FILE="config-boot.h"

### MBedtls wants a heap
CONFIG_HEAP_MEM_POOL_SIZE=16384

### Enable the flash driver
CONFIG_FLASH=y
CONFIG_SOC_FLASH_STM32F4=y
```

## src/main.c
```c
/*
 * Copyright (c) 2012-2014 Wind River Systems, Inc.
 *
 * Licensed under the Apache License, Version 2.0 (the "License");
 * you may not use this file except in compliance with the License.
 * You may obtain a copy of the License at
 *
 *     http://www.apache.org/licenses/LICENSE-2.0
 *
 * Unless required by applicable law or agreed to in writing, software
 * distributed under the License is distributed on an "AS IS" BASIS,
 * WITHOUT WARRANTIES OR CONDITIONS OF ANY KIND, either express or implied.
 * See the License for the specific language governing permissions and
 * limitations under the License.
 */

#include <zephyr.h>
#include <misc/printk.h>
#include <flash.h>
#include <asm_inline.h>

#if defined(MCUBOOT_TARGET_CONFIG)
#include MCUBOOT_TARGET_CONFIG
#else
#error "Board is currently not supported by bootloader"
#endif

#include "bootutil/image.h"
#include "bootutil/bootutil.h"

/* Same offset needs to be used by Zephyr (CONFIG_BOOT_HEADER) */
#define VTOR_OFFSET 0x80

struct device *boot_flash_device;

struct vector_table {
	uint32_t msp;
	uint32_t reset;
};

void os_heap_init(void);

void main(void)
{
	struct boot_rsp rsp;
	struct vector_table *vt;
	int rc;

	os_heap_init();

	boot_flash_device = device_get_binding(FLASH_DRIVER_NAME);
	if (!boot_flash_device) {
		printk("Flash device not found\n");
		while (1)
			;
	}

	rc = boot_go(&rsp);
	if (rc != 0) {
		printk("Unable to find bootable image\n");
		while (1)
			;
	}

	printk("Bootloader chain: 0x%x\n", rsp.br_image_addr);
	vt = (struct vector_table *)(rsp.br_image_addr + VTOR_OFFSET);
	irq_lock();
	_MspSet(vt->msp);

	printk("Setting vector table to %p\n", vt);

	/* Not all targets set the VTOR, so just set it. */
	_scs_relocate_vector_table((void *) vt);

	((void (*)(void))vt->reset)();

	printk("Never should get here\n");
	while (1)
		;
}
```

## src/flash_map.c
```c
/*
 * Licensed to the Apache Software Foundation (ASF) under one
 * or more contributor license agreements.  See the NOTICE file
 * distributed with this work for additional information
 * regarding copyright ownership.  The ASF licenses this file
 * to you under the Apache License, Version 2.0 (the
 * "License"); you may not use this file except in compliance
 * with the License.  You may obtain a copy of the License at
 *
 *  http://www.apache.org/licenses/LICENSE-2.0
 *
 * Unless required by applicable law or agreed to in writing,
 * software distributed under the License is distributed on an
 * "AS IS" BASIS, WITHOUT WARRANTIES OR CONDITIONS OF ANY
 * KIND, either express or implied.  See the License for the
 * specific language governing permissions and limitations
 * under the License.
 */

#include <zephyr.h>
#include <misc/printk.h>
#include <flash.h>

#include <flash_map/flash_map.h>
#include <sysflash/sysflash.h>

extern struct device *boot_flash_device;

/*
 * The flash area describes essentially the partition table of the
 * flash.  In this case, it starts with FLASH_AREA_IMAGE_0.
 */
static const struct flash_area part_map[] = {
	{
		.fa_id = FLASH_AREA_IMAGE_0,
		.fa_off = 0x20000,
		.fa_size = 0x20000,
	},
	{
		.fa_id = FLASH_AREA_IMAGE_1,
		.fa_off = 0x40000,
		.fa_size = 0x20000,
	},
	{
		.fa_id = FLASH_AREA_IMAGE_SCRATCH,
		.fa_off = 0x60000,
		.fa_size = 0x20000,
	},
};

/*
 * The K64F has a simple 1MB of uniform 4KB sectors.  Initially, we'll
 * use the same partition layout as the Carbon board to make
 * development easier.
 */

/*
 * `open` a flash area.  The `area` in this case is not the individual
 * sectors, but describes the particular flash area in question.
 */
int flash_area_open(uint8_t id, const struct flash_area **area)
{
	int i;
	printk("%s: area %d\n", __func__, id);

	for (i = 0; i < ARRAY_SIZE(part_map); i++) {
		if (id == part_map[i].fa_id)
			break;
	}
	if (i == ARRAY_SIZE(part_map))
		return -1;

	*area = &part_map[i];
	return 0;
}

/*
 * Nothing to do on close.
 */
void flash_area_close(const struct flash_area *area)
{
}

int flash_area_read(const struct flash_area *area, uint32_t off, void *dst,
		    uint32_t len)
{
	// printk("%s: area=%d, off=%x, len=%x\n", __func__, area->fa_id, off, len);
	return flash_read(boot_flash_device, area->fa_off + off, dst, len);
}

int flash_area_write(const struct flash_area *area, uint32_t off, const void *src,
		     uint32_t len)
{
	printk("%s: area=%d, off=%x, len=%x\n", __func__, area->fa_id, off, len);
	return flash_write(boot_flash_device, area->fa_off + off, src, len);
}

int flash_area_erase(const struct flash_area *area, uint32_t off, uint32_t len)
{
	printk("%s: area=%d, off=%x, len=%x\n", __func__, area->fa_id, off, len);
	return flash_erase(boot_flash_device, area->fa_off + off, len);
}

uint8_t flash_area_align(const struct flash_area *area)
{
	return 1;
}

/*
 * This depends on the mappings defined in sysflash.h, and assumes
 * that slot 0, slot 1, and the scratch area area contiguous.
 */
int flash_area_id_from_image_slot(int slot)
{
	return slot + FLASH_AREA_IMAGE_0;
}

/*
 * Lookup the sector map for a given flash area.  This should fill in
 * `ret` with all of the sectors in the area.  `*cnt` will be set to
 * the storage at `ret` and should be set to the final number of
 * sectors in this area.
 */
int flash_area_to_sectors(int idx, int *cnt, struct flash_area *ret)
{
	uint32_t off;

	printk("%s: lookup area %d\n", __func__, idx);
	/*
	 * This simple layout has uniform slots, so just fill in the
	 * right one.
	 */
	if (idx < FLASH_AREA_IMAGE_0 || idx > FLASH_AREA_IMAGE_SCRATCH)
		return -1;

	if (*cnt < 1)
		return -1;

	off = (idx - FLASH_AREA_IMAGE_0 + 1) * 0x20000;

	ret->fa_id = idx;
	ret->fa_device_id = 0;
	ret->pad16 = 0;
	ret->fa_off = off;
	ret->fa_size = 0x20000;

	return 0;
}
```

## src/hal_flash.c
```c
/*
 * Licensed to the Apache Software Foundation (ASF) under one
 * or more contributor license agreements.  See the NOTICE file
 * distributed with this work for additional information
 * regarding copyright ownership.  The ASF licenses this file
 * to you under the Apache License, Version 2.0 (the
 * "License"); you may not use this file except in compliance
 * with the License.  You may obtain a copy of the License at
 *
 *  http://www.apache.org/licenses/LICENSE-2.0
 *
 * Unless required by applicable law or agreed to in writing,
 * software distributed under the License is distributed on an
 * "AS IS" BASIS, WITHOUT WARRANTIES OR CONDITIONS OF ANY
 * KIND, either express or implied.  See the License for the
 * specific language governing permissions and limitations
 * under the License.
 */

#include <zephyr.h>
#include <misc/printk.h>

#include "hal/hal_flash.h"

/* All of the currently supported devices allow single byte writes. */
uint8_t hal_flash_align(uint8_t flash_id)
{
	return 1;
}
```

## src/os.c
```c
/*
 * Licensed to the Apache Software Foundation (ASF) under one
 * or more contributor license agreements.  See the NOTICE file
 * distributed with this work for additional information
 * regarding copyright ownership.  The ASF licenses this file
 * to you under the Apache License, Version 2.0 (the
 * "License"); you may not use this file except in compliance
 * with the License.  You may obtain a copy of the License at
 *
 *  http://www.apache.org/licenses/LICENSE-2.0
 *
 * Unless required by applicable law or agreed to in writing,
 * software distributed under the License is distributed on an
 * "AS IS" BASIS, WITHOUT WARRANTIES OR CONDITIONS OF ANY
 * KIND, either express or implied.  See the License for the
 * specific language governing permissions and limitations
 * under the License.
 */

#include <zephyr.h>
#include <misc/printk.h>

#include "os/os_heap.h"

#define D(x) x { \
	printk("Unimplemented function: %s\n", __func__); \
	while (1) \
		; \
}

D(void *os_malloc(size_t size))
```
